/**
 * @cliArgs --board "/ti/boards/MSP_EXP432P401R" --product "simplelink_msp432p4_sdk@3.40.01.02"
 * @versions {"data":"2021040816","timestamp":"2021040816","tool":"1.8.1+1900","templates":null}
 */

/**
 * Import the modules used in this configuration.
 */
const GPIO  = scripting.addModule("/ti/drivers/GPIO", {}, false);
const GPIO1 = GPIO.addInstance();
const GPIO2 = GPIO.addInstance();
const GPIO3 = GPIO.addInstance();
const GPIO4 = GPIO.addInstance();
const GPIO5 = GPIO.addInstance();
const GPIO6 = GPIO.addInstance();
const GPIO7 = GPIO.addInstance();
const GPIO8 = GPIO.addInstance();
const RTOS  = scripting.addModule("/ti/drivers/RTOS");

/**
 * Write custom configuration values to the imported modules.
 */
GPIO1.$name           = "CONFIG_GPIO_SEG_A";
GPIO1.mode            = "Output";
GPIO1.gpioPin.$assign = "boosterpack.24";

GPIO2.$name           = "CONFIG_GPIO_SEG_B";
GPIO2.mode            = "Output";
GPIO2.gpioPin.$assign = "boosterpack.5";

GPIO3.$name           = "CONFIG_GPIO_SEG_C";
GPIO3.mode            = "Output";
GPIO3.gpioPin.$assign = "boosterpack.25";

GPIO4.$name           = "CONFIG_GPIO_SEG_D";
GPIO4.mode            = "Output";
GPIO4.gpioPin.$assign = "boosterpack.6";

GPIO5.$name           = "CONFIG_GPIO_SEG_E";
GPIO5.mode            = "Output";
GPIO5.gpioPin.$assign = "boosterpack.26";

GPIO6.$name           = "CONFIG_GPIO_SEG_F";
GPIO6.mode            = "Output";
GPIO6.gpioPin.$assign = "boosterpack.27";

GPIO7.$name           = "CONFIG_GPIO_SEG_G";
GPIO7.mode            = "Output";
GPIO7.gpioPin.$assign = "boosterpack.8";

GPIO8.$name            = "CONFIG_GPIO_BUTTON_S1";
GPIO8.pull             = "Pull Up";
GPIO8.interruptTrigger = "Falling Edge";
GPIO8.$hardware        = system.deviceData.board.components.S1;
GPIO8.callbackFunction = "GPIO_Callback_Button_S1";

const Power                   = scripting.addModule("/ti/drivers/Power", {}, false);
Power.performanceLevel3.$name = "ti_drivers_power_PowerMSP432PerfLevels0";
Power.performanceLevel2.$name = "ti_drivers_power_PowerMSP432PerfLevels1";
Power.performanceLevel1.$name = "ti_drivers_power_PowerMSP432PerfLevels2";
Power.performanceLevel0.$name = "ti_drivers_power_PowerMSP432PerfLevels3";

RTOS.name = "NoRTOS";

/**
 * Pinmux solution for unlocked pins/peripherals. This ensures that minor changes to the automatic solver in a future
 * version of the tool will not impact the pinmux you originally saw.  These lines can be completely deleted in order to
 * re-solve from scratch.
 */
GPIO8.gpioPin.$suggestSolution        = "5";
RTOS.timer0.resource.$suggestSolution = "Timer_A0";
